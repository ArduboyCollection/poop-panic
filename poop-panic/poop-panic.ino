#include "Arduboy2.h"
#include "ArduboyTones.h"

Arduboy2 arduboy;
ArduboyTones sound(arduboy.audio.enabled);

#define MAX_ANIMALS 30
#define MAX_POOPS 30

unsigned int tones[] = {NOTE_C4, NOTE_D4, NOTE_E4, NOTE_F4,NOTE_G4,NOTE_A4,NOTE_B4,NOTE_C5};


struct Char {
  int x;
  int y;
  int vx;
  int vy;
  int poopCycle;
  int poopTimer;
 
  bool visible;
};

Char my;
Char animals[MAX_ANIMALS];
Char poops[MAX_POOPS];

#define M_TITLE 0
#define M_GAME 1
#define M_OVER 2
#define M_CLEAR 3
#define M_ALLCLEAR 4

#define GAMEWIDTH 128 - 8

byte mode = M_TITLE;
byte level = 1;
int timer = 0;
int counter = 0;

byte upTrigger = 0;
byte downTrigger = 0;
byte aTrigger = 0;



PROGMEM const unsigned char poopBitmap[] = {0xc0, 0xb0, 0xa8, 0xad, 0xae, 0xf0, 0xa0, 0xc0};
PROGMEM const unsigned char rightAnimalBitmap[] = {0xf8, 0x18, 0x18, 0x18, 0x18, 0xff, 0x0e, 0x0f};
PROGMEM const unsigned char leftAnimalBitmap[] = {0x0f, 0x0e, 0x0f, 0xf8, 0x18, 0x18, 0x18, 0xf8};
PROGMEM const unsigned char rightAnimal2Bitmap[] = {0xfe, 0x3f, 0x5f, 0x3a, 0xf6, 0x0f, 0x7f, 0x46};
PROGMEM const unsigned char leftAnimal2Bitmap[] = {0x46, 0x3f, 0x07, 0xff, 0x1b, 0x1d, 0x1f, 0xfe, 
};

PROGMEM const unsigned char myBitmap[] = {0x08, 0x90, 0xd6, 0x7f, 0x7f, 0xd6, 0x90, 0x08};
PROGMEM const unsigned char startBitmap[] = {
0x00, 0x00, 0x00, 0x00, 0x00, 0xc0, 0x40, 0x40, 0x80, 0x00, 0x00, 0x00, 0x00, 0x00, 0x00, 0x00,
0x00, 0x00, 0x00, 0x00, 0x00, 0x00, 0x00, 0x00, 0x00, 0x00, 0x00, 0x00, 0x00, 0x00, 0x00, 0x00,
0x00, 0x00, 0x00, 0x00, 0x00, 0x00, 0x00, 0x00, 0x00, 0x00, 0x00, 0x00, 0x00, 0x00, 0x00, 0x00,
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0x00, 0x3c, 0x42, 0x42, 0x3c, 0x40, 0x00, 0x7e, 0x04, 0x02, 0x02, 0x7c, 0x00, 0x7d, 0x00, 0x00
};


void setup(){
  arduboy.begin();
  arduboy.setFrameRate(50);

  for(byte i = 0; i < MAX_ANIMALS; i ++){
    animals[i].visible  = false;
  }
  for(byte i = 0; i < MAX_POOPS; i ++){
    poops[i].visible  = false;
  }

  my.visible = true;
  my.x = 64;
  my.y = 32;

}

void moveAnimals(){
  for(byte i = 0; i < MAX_ANIMALS; i ++){
    if(animals[i].visible){
      animals[i].x += animals[i].vx;
      if(animals[i].x < 0){
        animals[i].x = 0;
        animals[i].vx *= -1;
      }
      if(animals[i].x > GAMEWIDTH){
        animals[i].x = GAMEWIDTH;
        animals[i].vx *= -1;
      }

      animals[i].y += animals[i].vy;
      if(animals[i].y < 0){
        animals[i].y = 0;
        animals[i].vy *= -1;
      }
      if(animals[i].y > 64){
        animals[i].y = 64;
        animals[i].vy *= -1;
      }

      animals[i].poopTimer ++;
      if(animals[i].poopCycle == animals[i].poopTimer){
        animals[i].poopTimer = 0;
        createPoop(animals[i]);
      }

    }
  }
}
byte getFreeAnimalId(){
  for(byte i = 0; i < MAX_ANIMALS; i ++){
    if(!animals[i].visible){
      return i;
    }
  }
  return -1;
}

void setupStage(){
  // claer animals
  for(byte i = 0; i < MAX_ANIMALS; i ++){
    animals[i].visible  = false;
  }
  // claer poops
  for(byte i = 0; i < MAX_POOPS; i ++){
    poops[i].visible  = false;
  }


  switch(level){
    case 1:
      // set animals
      for(int i = 0; i < 2; i ++){
        byte animalId = getFreeAnimalId();
        animals[animalId].visible = true;
        animals[animalId].x = random(0,GAMEWIDTH);
        animals[animalId].y = random(0,64);
        animals[animalId].vx = random(-2,2);
        animals[animalId].vy = random(-2,2);
        animals[animalId].poopCycle = 20;
        animals[animalId].poopTimer = random(0,20 - 1);
      }
    break;
    case 2:
      // set animals
      for(int i = 0; i < 3; i ++){
        byte animalId = getFreeAnimalId();
        animals[animalId].visible = true;
        animals[animalId].x = random(0,GAMEWIDTH);
        animals[animalId].y = random(0,64);
        animals[animalId].vx = random(-2,2);
        animals[animalId].vy = random(-2,2);
        animals[animalId].poopCycle = 20;
        animals[animalId].poopTimer = random(0,20 - 1);
      }
    break;
    case 3:
      // set animals
      for(int i = 0; i < 1; i ++){
        byte animalId = getFreeAnimalId();
        animals[animalId].visible = true;
        animals[animalId].x = random(0,GAMEWIDTH);
        animals[animalId].y = random(0,64);
        animals[animalId].vx = random(-2,2);
        animals[animalId].vy = random(-2,2);
        animals[animalId].poopCycle = 20;
        animals[animalId].poopTimer = random(0,20 - 1);
      }
      for(int i = 0; i < 1; i ++){
        byte animalId = getFreeAnimalId();
        animals[animalId].visible = true;
        animals[animalId].x = random(0,GAMEWIDTH);
        animals[animalId].y = random(0,64);
        animals[animalId].vx = random(-2,2);
        animals[animalId].vy = random(-2,2);
        animals[animalId].poopCycle = 5;
        animals[animalId].poopTimer = random(0,5 - 1);
      }
    break;
    case 4:
      // set animals
      for(int i = 0; i < 3; i ++){
        byte animalId = getFreeAnimalId();
        animals[animalId].visible = true;
        animals[animalId].x = random(0,GAMEWIDTH);
        animals[animalId].y = random(0,64);
        animals[animalId].vx = random(-2,2);
        animals[animalId].vy = random(-2,2);
        animals[animalId].poopCycle = 20;
        animals[animalId].poopTimer = random(0,20 - 1);
      }
       for(int i = 0; i < 1; i ++){
        byte animalId = getFreeAnimalId();
        animals[animalId].visible = true;
        animals[animalId].x = random(0,GAMEWIDTH);
        animals[animalId].y = random(0,64);
        animals[animalId].vx = random(-2,2);
        animals[animalId].vy = random(-2,2);
        animals[animalId].poopCycle = 5;
        animals[animalId].poopTimer = random(0,5 - 1);
      }
    break;
    case 5:
      // set animals
      {
        byte animalId = getFreeAnimalId();
        animals[animalId].visible = true;
        animals[animalId].x = 0;
        animals[animalId].y = 16;
        animals[animalId].vx = 1;
        animals[animalId].vy = 0;
        animals[animalId].poopCycle = 10;
        animals[animalId].poopTimer = random(0,10 - 1);
      }
      {
        byte animalId = getFreeAnimalId();
        animals[animalId].visible = true;
        animals[animalId].x = 8;
        animals[animalId].y = 16 + 8;
        animals[animalId].vx = 1;
        animals[animalId].vy = 0;
        animals[animalId].poopCycle = 10;
        animals[animalId].poopTimer = random(0,10 - 1);
      }
      {
        byte animalId = getFreeAnimalId();
        animals[animalId].visible = true;
        animals[animalId].x = 16;
        animals[animalId].y = 16 + 16;
        animals[animalId].vx = 1;
        animals[animalId].vy = 0;
        animals[animalId].poopCycle = 10;
        animals[animalId].poopTimer = random(0,10 - 1);
      }
      {
        byte animalId = getFreeAnimalId();
        animals[animalId].visible = true;
        animals[animalId].x = 24;
        animals[animalId].y = 16 + 24;
        animals[animalId].vx = 1;
        animals[animalId].vy = 0;
        animals[animalId].poopCycle = 10;
        animals[animalId].poopTimer = random(0,10 - 1);
      }

    break;
    case 6:
      // set animals
      {
        byte animalId = getFreeAnimalId();
        animals[animalId].visible = true;
        animals[animalId].x = 0;
        animals[animalId].y = 16;
        animals[animalId].vx = 1;
        animals[animalId].vy = 0;
        animals[animalId].poopCycle = 10;
        animals[animalId].poopTimer = random(0,10 - 1);
      }
      {
        byte animalId = getFreeAnimalId();
        animals[animalId].visible = true;
        animals[animalId].x = 8;
        animals[animalId].y = 16 + 8;
        animals[animalId].vx = 1;
        animals[animalId].vy = 0;
        animals[animalId].poopCycle = 10;
        animals[animalId].poopTimer = random(0,10 - 1);
      }
      {
        byte animalId = getFreeAnimalId();
        animals[animalId].visible = true;
        animals[animalId].x = 16;
        animals[animalId].y = 16 + 16;
        animals[animalId].vx = 1;
        animals[animalId].vy = 0;
        animals[animalId].poopCycle = 10;
        animals[animalId].poopTimer = random(0,10 - 1);
      }
      {
        byte animalId = getFreeAnimalId();
        animals[animalId].visible = true;
        animals[animalId].x = 24;
        animals[animalId].y = 16 + 24;
        animals[animalId].vx = 1;
        animals[animalId].vy = 0;
        animals[animalId].poopCycle = 10;
        animals[animalId].poopTimer = random(0,10 - 1);
      }
      // ==================
      {
        byte animalId = getFreeAnimalId();
        animals[animalId].visible = true;
        animals[animalId].x = 0;
        animals[animalId].y = 16 + 32;
        animals[animalId].vx = 2;
        animals[animalId].vy = 0;
        animals[animalId].poopCycle = 20;
        animals[animalId].poopTimer = random(0,20 - 1);
      }
      {
        byte animalId = getFreeAnimalId();
        animals[animalId].visible = true;
        animals[animalId].x = 8;
        animals[animalId].y = 16 + 40;
        animals[animalId].vx = 2;
        animals[animalId].vy = 0;
        animals[animalId].poopCycle = 20;
        animals[animalId].poopTimer = random(0,20 - 1);
      }

    break;
  }

  timer = 3000;
}
byte getFreePoopId(){
  for(byte i = 0; i < MAX_POOPS; i ++){
    if(!poops[i].visible){
      return i;
    }
  }
  return -1;
}
void createPoop(Char c){
  byte poopId = getFreePoopId();
  poops[poopId].x = c.x;
  poops[poopId].y = c.y;
  poops[poopId].visible = true;
}

void cleanPoops(){
  for(byte i = 0; i < MAX_POOPS; i ++){
    if(abs(poops[i].x - my.x) <= 8 && abs(poops[i].y - my.y) <= 8){
      poops[i].visible = false;
    }
  }
}

void game(){
  counter ++;
  if(arduboy.pressed(LEFT_BUTTON)){
    my.x --;
    if(my.x < 0){
      my.x = 0;
    }
  }
  if(arduboy.pressed(RIGHT_BUTTON)){
    my.x ++;
    if(my.x > GAMEWIDTH){
      my.x = GAMEWIDTH;
    }
  }
  if(arduboy.pressed(UP_BUTTON)){
    my.y --;
    if(my.y < 0){
      my.y = 0;
    }
  }
  if(arduboy.pressed(DOWN_BUTTON)){
    my.y ++;
    if(my.y > 64){
      my.y = 64;
    }
 
  }

  if(counter % 10 == 0){
    moveAnimals();
  }


  cleanPoops();
  timer --;
  if(timer == 0){
    mode = M_CLEAR;
    if(level == 6){
      mode = M_ALLCLEAR;
    }
  }

  int poopCount = 0;
  for(byte i = 0; i < MAX_POOPS; i ++){
    if(poops[i].visible){
      poopCount ++;
    }
  }
  if(poopCount >= 8){
    mode = M_OVER;
  }

  if(counter % 40 == 0){
    sound.tone(tones[0], 100);
  }
  if(counter % 40 == 20){
    sound.tone(tones[poopCount], 100);
  }

  arduboy.clear();

  arduboy.setCursor(4,0);
  arduboy.print("level:");
  arduboy.setCursor(38,0);
  arduboy.print(level);

  arduboy.setCursor(50,0);
  arduboy.print("remain:");
  arduboy.setCursor(100,0);
  arduboy.print(timer);

  //arduboy.drawRect(my.x - 4, my.y - 4, 8, 8, 1);
  arduboy.drawBitmap(my.x - 4, my.y - 4, myBitmap, 8, 8, 1);

  for(byte i = 0; i < MAX_ANIMALS; i ++){
    if(animals[i].visible){
      //arduboy.drawRect(animals[i].x - 4, animals[i].y - 4, 8, 8, 1);
      if(animals[i].poopCycle < 20){
        if(animals[i].vx > 0){
          arduboy.drawBitmap(animals[i].x - 4, animals[i].y - 4, rightAnimal2Bitmap, 8, 8, 1);
        }else{
          arduboy.drawBitmap(animals[i].x - 4, animals[i].y - 4, leftAnimal2Bitmap, 8, 8, 1);
        }
      }else{
        if(animals[i].vx > 0){
          arduboy.drawBitmap(animals[i].x - 4, animals[i].y - 4, rightAnimalBitmap, 8, 8, 1);
        }else{
          arduboy.drawBitmap(animals[i].x - 4, animals[i].y - 4, leftAnimalBitmap, 8, 8, 1);
        }
 
      }
    }
  }
  for(byte i = 0; i < MAX_POOPS; i ++){
    if(poops[i].visible){
      //arduboy.fillRect(poops[i].x - 4, poops[i].y - 4, 8, 8, 1);
      arduboy.drawBitmap(poops[i].x - 4, poops[i].y - 4, poopBitmap, 8, 8, 1);
    }
  }

  for(byte i = 0; i < 8; i ++){
    if(poopCount == i){
      arduboy.fillRect(128 - 4 , (7 - i) * 8 + 2, 4, 4, 1);
    }else{
      arduboy.drawRect(128 - 3 , (7 - i) * 8 + 3, 2, 2, 1);
    }
  }
}

void title(){

  if(aTrigger == 1){
    mode = M_GAME;
    setupStage();
  }
  if(upTrigger == 1){
    level ++;
    if(level > 6){
      level = 6;
    }
  }
  if(downTrigger == 1){
    level --;
    if(level < 1){
      level = 1;
    }
  }

  arduboy.clear();
  arduboy.drawBitmap(0, 0 , startBitmap, 128, 64, 1);

  arduboy.setCursor(4,48);
  arduboy.print(level);


  /*
  arduboy.setCursor(4,9);
  arduboy.print(F("Zoo Clean"));
  arduboy.setCursor(64,48);
  arduboy.print(F("@ina_ani"));
  */

}

void clear(){

  if(aTrigger == 1){
    mode = M_GAME;
    level ++;
    setupStage();
  }

  //arduboy.clear();
  arduboy.setCursor(4,9);

  arduboy.print(F("clear"));
}
void allClear(){

  if(arduboy.pressed(A_BUTTON)){
    mode = M_TITLE;
    level = 1;
  }

  //arduboy.clear();
  arduboy.setCursor(4,9);

  arduboy.print(F("all clear"));
}


void over(){
  counter ++;

  if(aTrigger == 1){
    mode = M_TITLE;
    level = 1;
  }

  //arduboy.clear();
  arduboy.setCursor(4,9);

  arduboy.print(F("game over!"));

  if(counter % 10 == 0){
    arduboy.drawBitmap(random(0,128 - 8), random(16, 64), poopBitmap, 8, 8, 1);
  }
}

void loop(){
  if(!arduboy.nextFrame()){
    return;
  }

  if(arduboy.pressed(UP_BUTTON)){
    upTrigger ++;
  }else{
    upTrigger = 0;
  }
  if(arduboy.pressed(DOWN_BUTTON)){
    downTrigger ++;
  }else{
    downTrigger = 0;
  }
  if(arduboy.pressed(A_BUTTON)){
    aTrigger ++;
  }else{
    aTrigger = 0;
  }



  switch(mode){
    case M_TITLE:
      title();
      break;
    case M_GAME:
      game();
      break;
    case M_OVER:
      over();
      break;
    case M_CLEAR:
      clear();
      break;
    case M_ALLCLEAR:
      allClear();
  }

  arduboy.display();
}
